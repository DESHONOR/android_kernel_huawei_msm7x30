## arch/arm/mach-msm/huawei/Kconfig.board
```kconfig
source "arch/arm/mach-msm/huawei/u8860/Kconfig"
source "arch/arm/mach-msm/huawei/u8800/Kconfig"
```

## arch/arm/mach-msm/huawei/u8800/Kconfig
```kconfig
config MACH_U8800
	depends on ARCH_MSM7X30
	depends on !MSM_STACKED_MEMORY
	select MACH_HUAWEI
	bool "HUAWEI U8800"
	help
		Support for the Huawei U8800 board.
```

## arch/arm/mach-msm/huawei/u8860/Kconfig
```kconfig
config MACH_U8860
	depends on ARCH_MSM7X30
	select MACH_HUAWEI
	bool "Huawei u8860"
	help
	  Support for the Huawei u8860 Honor device.
```
